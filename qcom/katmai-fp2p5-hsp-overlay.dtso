// SPDX-License-Identifier: BSD-3-Clause
/*
 * Copyright (c) 2025 Qualcomm Innovation Center, Inc. All rights reserved.
 */

/dts-v1/;
/plugin/;

#include <dt-bindings/interconnect/qcom,yupik.h>
#include "katmai-hsp.dtsi"

/ {
	model = "Qualcomm Technologies, Inc. Katmai FP2P5 IoT HSP";
	compatible = "qcom,yupik-iot-idp", "qcom,yupik-iot", "qcom,idp";
	qcom,msm-id = <0x200001F1 0x10000>, <0x2000023F 0x10000>, <0x20000240 0x10000>;
	qcom,board-id = <34 1>;
};
