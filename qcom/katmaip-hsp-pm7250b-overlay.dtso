// SPDX-License-Identifier: BSD-3-Clause
/*
 * Copyright (c) 2025 Qualcomm Innovation Center, Inc. All rights reserved.
 */

/dts-v1/;
/plugin/;

#include "katmaip-hsp-pm7250b.dtsi"

/ {
	model = "Qualcomm Technologies, Inc. KatmaiP IOT HSP + PM7250B";
	compatible = "qcom,yupikp-iot-idp", "qcom,yupikp-iot", "qcom,idp";
	qcom,msm-id = <0x40001F2 0x10000>, <0x400023F 0x10000>, <0x4000240 0x10000>;
	qcom,board-id = <34 1>;
};
