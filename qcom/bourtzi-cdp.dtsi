// SPDX-License-Identifier: BSD-3-Clause
/*
 * Copyright (c) Qualcomm Technologies, Inc. and/or its subsidiaries.
 */

#include "bourtzi-pmic-overlay.dtsi"
#include "bourtzi-pmiv010x.dtsi"

&pmiv010x_amoled {
	status = "okay";
};

&pmiv010x_amoled_ecm {
	status = "okay";
	nvmem-names = "amoled-ecm-sdam0", "amoled-ecm-sdam1";
	nvmem = <&pmk8350_sdam_13>, <&pmk8350_sdam_14>;
	interrupt-names = "ecm-sdam0", "ecm-sdam1";
	interrupts = <0x0 0x7c 0x1 IRQ_TYPE_EDGE_RISING>,
		     <0x0 0x7d 0x1 IRQ_TYPE_EDGE_RISING>;
};
