// SPDX-License-Identifier: BSD-3-Clause
/*
 * Copyright (c) Qualcomm Technologies, Inc. and/or its subsidiaries.
 */

#include "sa8797p-gunyah-vm-lv.dtsi"

&vm_config {
	/* Pass through regions */
	iomemory-ranges = <
		/* GPU region */
		0x0 0x3D41000 0x0 0x3D41000 0x0 0x1000 0x0
		0x0 0x9841000 0x0 0x9841000 0x0 0x1000 0x0
		/* MPROC NS2 IPCC region */
		0x0 0x9009000 0x0 0x9009000 0x0 0x1000 0x0
	>;

	/* Pass through IRQs */
	gic-irq-ranges = <
		/* GPU GIC IRQ */
		677 677
		894 894
		/* MPROC NS2 IPCC GIC IRQ */
		990 990
	>;
};
