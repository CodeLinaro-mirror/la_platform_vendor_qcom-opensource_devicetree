// SPDX-License-Identifier: BSD-3-Clause
/*
 * Copyright (c) 2025 Qualcomm Innovation Center, Inc. All rights reserved.
 */

#include "katmai-fp3.dtsi"

/ {
	model = "Qualcomm Technologies, Inc. KATMAIP-FP3 SoC";
	compatible = "qcom,yupikp-iot";
	qcom,msm-id = <0xC00023F 0x10000>;
};
