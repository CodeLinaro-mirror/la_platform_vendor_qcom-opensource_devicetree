// SPDX-License-Identifier: BSD-3-Clause
/*
 * Copyright (c) 2024 Qualcomm Innovation Center, Inc. All rights reserved.
 */

#include <dt-bindings/clock/qcom,gcc-canoe.h>
#include <dt-bindings/gpio/gpio.h>

&soc {
	pcie: pcie@1c00000 {
		compatible = "qcom,pci-msm";

		reg = <0x0 0x01c00000 0x0 0x3000>,
			<0x0 0x01c06000 0x0 0x2000>,
			<0x0 0x40000000 0x0 0xf1d>,
			<0x0 0x40000f20 0x0 0xa8>,
			<0x0 0x40001000 0x0 0x1000>,
			<0x0 0x40100000 0x0 0x100000>;

		reg-names = "parf", "phy", "dm_core", "elbi", "iatu",
			"conf";

		cell-index = <0>;
		linux,pci-domain = <0>;

		#address-cells = <3>;
		#size-cells = <2>;
		ranges = <0x01000000 0x0 0x40200000 0x0 0x40200000 0x0 0x100000>,
			<0x02000000 0x0 0x40300000 0x0 0x40300000 0x0 0x3d00000>;

		device_type = "pci";
		interrupts = <GIC_SPI 140 IRQ_TYPE_LEVEL_HIGH
				GIC_SPI 149 IRQ_TYPE_LEVEL_HIGH
				GIC_SPI 150 IRQ_TYPE_LEVEL_HIGH
				GIC_SPI 151 IRQ_TYPE_LEVEL_HIGH
				GIC_SPI 152 IRQ_TYPE_LEVEL_HIGH>;

		interrupt-names = "int_global_int", "int_a", "int_b", "int_c",
				"int_d";

		msi-map = <0x0 &gic_its 0x1400 0x1>,
			<0x100 &gic_its 0x1401 0x1>; /* 32 event IDs */

		perst-gpio = <&tlmm 102 GPIO_ACTIVE_HIGH>;
		wake-gpio = <&tlmm 104 GPIO_ACTIVE_HIGH>;
		pinctrl-names = "default", "sleep";
		pinctrl-0 = <&pcie0_perst_default
				&pcie0_clkreq_default
				&pcie0_wake_default>;
		pinctrl-1 = <&pcie0_perst_default
				&pcie0_clkreq_sleep
				&pcie0_wake_default>;

		interconnect-names = "icc_path";
		interconnects = <&pcie_noc MASTER_PCIE_0 &mc_virt SLAVE_EBI1>;

		qcom,bw-scale = /* Gen1 */
				<RPMH_REGULATOR_LEVEL_LOW_SVS
				RPMH_REGULATOR_LEVEL_LOW_SVS
				19200000
				/* Gen2 */
				RPMH_REGULATOR_LEVEL_LOW_SVS
				RPMH_REGULATOR_LEVEL_LOW_SVS
				19200000
				/* Gen3 */
				RPMH_REGULATOR_LEVEL_NOM
				RPMH_REGULATOR_LEVEL_NOM
				100000000>;

		resets = <&gcc GCC_PCIE_0_BCR>,
			<&gcc GCC_PCIE_0_PHY_BCR>;
		reset-names = "pcie_0_core_reset",
				"pcie_0_phy_reset";

		dma-coherent;

		clocks = <&gcc GCC_PCIE_0_PIPE_CLK>,
			<&rpmhcc RPMH_CXO_CLK>,
			<&gcc GCC_PCIE_0_AUX_CLK>,
			<&gcc GCC_PCIE_0_CFG_AHB_CLK>,
			<&gcc GCC_PCIE_0_MSTR_AXI_CLK>,
			<&gcc GCC_PCIE_0_SLV_AXI_CLK>,
			<&tcsrcc TCSR_PCIE_0_CLKREF_EN>,
			<&gcc GCC_PCIE_0_SLV_Q2A_AXI_CLK>,
			<&gcc GCC_PCIE_0_PHY_RCHNG_CLK>,
			<&gcc GCC_DDRSS_PCIE_SF_QTB_CLK>,
			<&gcc GCC_AGGRE_NOC_PCIE_AXI_CLK>,
			<&gcc GCC_CNOC_PCIE_SF_AXI_CLK>,
			<&gcc GCC_PCIE_0_PIPE_CLK_SRC>,
			<&pcie_0_pipe_clk>,
			<&gcc GCC_PCIE_0_PHY_AUX_CLK>;
		clock-names = "pcie_pipe_clk", "pcie_ref_clk_src",
				"pcie_aux_clk", "pcie_cfg_ahb_clk",
				"pcie_mstr_axi_clk", "pcie_slv_axi_clk",
				"pcie_clkref_en", "pcie_slv_q2a_axi_clk",
				"pcie_rate_change_clk",
				"gcc_ddrss_pcie_sf_qtb_clk",
				"pcie_aggre_noc_axi_clk",
				"gcc_cnoc_pcie_sf_axi_clk", "pcie_pipe_clk_mux",
				"pcie_pipe_clk_ext_src", "pcie_phy_aux_clk";
		qcom,pcie-clock-frequency = <0>, <0>, <19200000>, <0>, <0>, <0>, <0>, <0>,
				<100000000>, <0>, <0>, <0>, <0>, <0>, <0>;
		clock-suppressible = <0>, <0>, <0>, <0>, <0>, <0>, <1>, <0>,
				<0>, <0>, <0>, <1>, <0>, <0>, <0>;

		gdsc-core-vdd-supply = <&gcc_pcie_0_gdsc>;
		vreg-1p2-supply = <&L1D>;
		vreg-0p9-supply = <&L3I>;
		vreg-qref-supply = <&L3D>;
		vreg-cx-supply = <&VDD_CX_LEVEL>;
		vreg-mx-supply = <&VDD_MXA_LEVEL>;
		/* <max min opt> */
		qcom,vreg-1p2-voltage-level = <1200000 1200000 18200>;
		qcom,vreg-0p9-voltage-level = <912000 880000 80900>;
		qcom,vreg-qref-voltage-level = <880000 880000 25700>;
		qcom,vreg-cx-voltage-level = <RPMH_REGULATOR_LEVEL_MAX
						RPMH_REGULATOR_LEVEL_NOM 0>;
		qcom,vreg-mx-voltage-level = <RPMH_REGULATOR_LEVEL_MAX
						RPMH_REGULATOR_LEVEL_NOM 0>;

		qcom,smmu-sid-base = <0x1400>;
		iommu-map = <0x0 &apps_smmu 0x1400 0x1>,
			<0x100 &apps_smmu 0x1401 0x1>;

		qcom,boot-option = <0x1>;
		qcom,aux-clk-freq = <20>; /* 19.2 MHz */
		qcom,drv-l1ss-timeout-us = <5000>;
		qcom,l1-2-th-scale = <2>;
		qcom,l1-2-th-value = <150>;
		qcom,ep-latency = <10>;
		qcom,num-parf-testbus-sel = <0xb9>;

		qcom,pcie-phy-ver = <300>;
		qcom,phy-status-offset = <0x414>;
		qcom,phy-status-bit = <7>;
		qcom,phy-power-down-offset = <0x440>;

		qcom,phy-sequence = <0x1440 0x03 0x0
					0x0030 0x1d 0x0
					0x0034 0x03 0x0
					0x007c 0x00 0x0
					0x0080 0xc0 0x0
					0x0084 0x00 0x0
					0x00b4 0x34 0x0
					0x00e0 0x05 0x0
					0x00e4 0x00 0x0
					0x00f4 0x07 0x0
					0x00f8 0x1f 0x0
					0x0058 0x90 0x0
					0x0118 0x00 0x0
					0x011c 0x1f 0x0
					0x0148 0x13 0x0
					0x014c 0x19 0x0
					0x02d8 0x0c 0x0
					0x02dc 0x0a 0x0
					0x02ec 0x04 0x0
					0x02f4 0x16 0x0
					0x0378 0x3a 0x0
					0x03a0 0x0d 0x0
					0x03b4 0x0b 0x0
					0x03d8 0x1c 0x0
					0x0128 0x20 0x0
					0x051c 0x09 0x0
					0x03e0 0x04 0x0
					0x02b8 0x01 0x0
					0x02bc 0x05 0x0
					0x02b4 0x00 0x0
					0x0258 0x40 0x0
					0x025c 0x02 0x0
					0x043c 0xc2 0x0
					0x0440 0xc2 0x0
					0x0448 0x1a 0x0
					0x0454 0x60 0x0
					0x0458 0x06 0x0
					0x045c 0x00 0x0
					0x046c 0x99 0x0
					0x0470 0x7a 0x0
					0x0484 0x1b 0x0
					0x0488 0x1b 0x0
					0x048c 0x98 0x0
					0x0494 0x7a 0x0
					0x031c 0xff 0x0
					0x0320 0xff 0x0
					0x0308 0x30 0x0
					0x030c 0x03 0x0
					0x0398 0x1f 0x0
					0x039c 0x1f 0x0
					0x0830 0x1d 0x0
					0x0834 0x03 0x0
					0x087c 0x00 0x0
					0x0880 0xc0 0x0
					0x0884 0x00 0x0
					0x08b4 0x34 0x0
					0x08e0 0x05 0x0
					0x08e4 0x00 0x0
					0x08f4 0x07 0x0
					0x08f8 0x1f 0x0
					0x0858 0x90 0x0
					0x0918 0x00 0x0
					0x091c 0x1f 0x0
					0x0948 0x13 0x0
					0x094c 0x19 0x0
					0x0ad8 0x0c 0x0
					0x0adc 0x0a 0x0
					0x0aec 0x04 0x0
					0x0af4 0x16 0x0
					0x0b78 0x3a 0x0
					0x0ba0 0x0d 0x0
					0x0bb4 0x0b 0x0
					0x0bd8 0x1c 0x0
					0x0928 0x20 0x0
					0x0d1c 0x09 0x0
					0x0be0 0x04 0x0
					0x0ab8 0x01 0x0
					0x0abc 0x05 0x0
					0x0ab4 0x00 0x0
					0x0a58 0x40 0x0
					0x0a5c 0x02 0x0
					0x0c3c 0xc2 0x0
					0x0c40 0xc2 0x0
					0x0c48 0x1a 0x0
					0x0c54 0x60 0x0
					0x0c58 0x06 0x0
					0x0c5c 0x00 0x0
					0x0c6c 0x99 0x0
					0x0c70 0x7a 0x0
					0x0c84 0x1b 0x0
					0x0c88 0x1b 0x0
					0x0c8c 0x98 0x0
					0x0c94 0x7a 0x0
					0x0b1c 0xff 0x0
					0x0b20 0xff 0x0
					0x0b08 0x30 0x0
					0x0b0c 0x03 0x0
					0x0b98 0x1f 0x0
					0x0b9c 0x1f 0x0
					0x1000 0x93 0x0
					0x1004 0x01 0x0
					0x1010 0x06 0x0
					0x1014 0x16 0x0
					0x1018 0x36 0x0
					0x101c 0x04 0x0
					0x1020 0x0a 0x0
					0x1024 0x1a 0x0
					0x1028 0x34 0x0
					0x1030 0x55 0x0
					0x1034 0x55 0x0
					0x1038 0x01 0x0
					0x103c 0x01 0x0
					0x1060 0xf8 0x0
					0x1064 0x01 0x0
					0x1070 0x06 0x0
					0x1074 0x16 0x0
					0x1078 0x36 0x0
					0x107c 0x0a 0x0
					0x1080 0x04 0x0
					0x1084 0x0d 0x0
					0x1088 0x41 0x0
					0x1090 0xab 0x0
					0x1094 0xaa 0x0
					0x1098 0x01 0x0
					0x109c 0x00 0x0
					0x10bc 0x0a 0x0
					0x10c0 0x01 0x0
					0x10cc 0x62 0x0
					0x10d0 0x02 0x0
					0x10dc 0x14 0x0
					0x10e0 0x90 0x0
					0x10e4 0x82 0x0
					0x10f4 0x0f 0x0
					0x1110 0x08 0x0
					0x1120 0x46 0x0
					0x1124 0x04 0x0
					0x1140 0x14 0x0
					0x1164 0x34 0x0
					0x1170 0xa0 0x0
					0x1174 0x16 0x0
					0x1184 0x88 0x0
					0x1188 0x14 0x0
					0x1198 0x0f 0x0
					0x1570 0x17 0x0
					0x1578 0x2e 0x0
					0x1590 0xcc 0x0
					0x15b8 0x40 0x0
					0x15dc 0x04 0x0
					0x15e0 0x02 0x0
					0x1818 0xc0 0x0
					0x15f8 0x00 0x0
					0x15fc 0x22 0x0
					0x180c 0x1d 0x0
					0x181c 0xc1 0x0
					0x1890 0x00 0x0
					0x18a0 0x16 0x0
					0x18f0 0x27 0x0
					0x18f4 0x27 0x0
					0x1908 0x02 0x0
					0x195c 0x2e 0x0
					0x197c 0x03 0x0
					0x1984 0x28 0x0
					0x198c 0x0f 0x0
					0x19ac 0xf2 0x0
					0x19c0 0xf2 0x0
					0x1400 0x00 0x0
					0x1444 0x03 0x0>;

		pcie_rp: pcie_rp {
			reg = <0 0 0 0 0>;
		};
	};
};
