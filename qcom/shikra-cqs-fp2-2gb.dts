// SPDX-License-Identifier: BSD-3-Clause
/*
 * Copyright (c) Qualcomm Technologies, Inc. and/or its subsidiaries.
 */

/dts-v1/;

#include "shikra-cqs-fp2.dtsi"
#include "shikra-2gb.dtsi"

/ {
	model = "Qualcomm Technologies, Inc. Shikra CQS FP2 SoC 2GB DDR";
	compatible = "qcom,shikra-cqs", "qcom,shikra";
	qcom,board-id = <0 0x400>;
};
