// SPDX-License-Identifier: BSD-3-Clause
/*
 * Copyright (c) Qualcomm Technologies, Inc. and/or its subsidiaries.
 */

/dts-v1/;

#include "colibri.dtsi"

/ {
	model = "Qualcomm Technologies, Inc. Colibri SoC";
	compatible = "qcom,colibri";
	qcom,board-id = <0 0>;
};

