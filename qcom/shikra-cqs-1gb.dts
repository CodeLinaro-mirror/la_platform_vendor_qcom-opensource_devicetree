// SPDX-License-Identifier: BSD-3-Clause
/*
 * Copyright (c) Qualcomm Technologies, Inc. and/or its subsidiaries.
 */

/dts-v1/;

#include "shikra-cqs.dtsi"
#include "shikra-1gb.dtsi"

/ {
	model = "Qualcomm Technologies, Inc. Shikra CQS SoC 1GB DDR";
	compatible = "qcom,shikra-cqs";
	qcom,board-id = <0 0x300>;
};
