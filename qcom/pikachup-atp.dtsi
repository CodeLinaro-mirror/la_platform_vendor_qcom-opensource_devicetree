// SPDX-License-Identifier: BSD-3-Clause
/*
 * Copyright (c) Qualcomm Technologies, Inc. and/or its subsidiaries.
 */

#include "pikachu-pmic-overlay.dtsi"
#include "pikachu-thermal-overlay.dtsi"

&soc {
};

&apps_rsc_drv2 {
	rpmh-regulator-gfxlvl {
		status = "okay";
	};
};
