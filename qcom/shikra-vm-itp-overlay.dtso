// SPDX-License-Identifier: BSD-3-Clause
/*
 * Copyright (c) Qualcomm Technologies, Inc. and/or its subsidiaries.
 */
/dts-v1/;
/plugin/;

#include "shikra-vm-avf.dtsi"
#include "shikra-vm-itp-avf.dtsi"

/ {
	model = "Qualcomm Technologies, Inc. Shikra SVM ITP";
	compatible = "qcom,shikra-itp", "qcom,shikra", "qcom,shikrap-itp",
			"qcom,shikrap", "qcom,itp";
	qcom,board-id = <0 0>;

	host {
	};
};

