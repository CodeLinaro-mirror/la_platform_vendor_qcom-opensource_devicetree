// SPDX-License-Identifier: BSD-3-Clause
/*
 * Copyright (c) Qualcomm Technologies, Inc. and/or its subsidiaries.
 */

#include "malabar-pmic-overlay.dtsi"
#include <dt-bindings/gpio/gpio.h>

&sdhc_2 {
	vdd-supply = <&L24B_E0>;
	qcom,vdd-voltage-level = <2960000 2960000>;
	qcom,vdd-current-level = <0 976210>;

	vdd-io-supply = <&L28B_E0>;
	qcom,vdd-io-voltage-level = <1800000 2960000>;
	qcom,vdd-io-current-level = <0 22000>;

	pinctrl-names = "default", "sleep";
	pinctrl-0 = <&sdc2_on>;
	pinctrl-1 = <&sdc2_off>;

	cd-gpios = <&tlmm 79 GPIO_ACTIVE_LOW>;

	status = "ok";
};

#include "malabar-pm7250b.dtsi"
