// SPDX-License-Identifier: BSD-3-Clause
/*
 * Copyright (c) Qualcomm Technologies, Inc. and/or its subsidiaries.
 */

#include "sdxkova-idp-m2.dtsi"

&soc {
};

&chosen {
	bootargs = "cpufreq.default_governor=performance pcie_ports=compat reboot=w";
};
