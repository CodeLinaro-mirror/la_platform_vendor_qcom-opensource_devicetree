// SPDX-License-Identifier: BSD-3-Clause
/*
 * Copyright (c) 2025 Qualcomm Innovation Center, Inc. All rights reserved.
 */

#include "katmai-fp2.dtsi"

/ {
	model = "Qualcomm Technologies, Inc. KATMAIP-FP2 SoC";
	compatible = "qcom,yupikp-iot";
	qcom,msm-id = <575 0x10000>;
	qcom,softsku-id = <2>;
};
