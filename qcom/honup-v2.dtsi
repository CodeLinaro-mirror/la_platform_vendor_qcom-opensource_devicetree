// SPDX-License-Identifier: BSD-3-Clause
/*
 * Copyright (c) 2024 Qualcomm Innovation Center, Inc. All rights reserved.
 */

#include "honu-v2.dtsi"

/ {
		model = "Qualcomm Technologies, Inc. HonuP v2 SoC";
		compatible = "qcom,honup";
		qcom,msm-id = <0x30295 0x20000>;
};
