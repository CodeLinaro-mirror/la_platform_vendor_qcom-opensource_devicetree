// SPDX-License-Identifier: BSD-3-Clause
/*
 * Copyright (c) Qualcomm Technologies, Inc. and/or its subsidiaries.
 */

#include "malabar-mtp.dtsi"

&sdhc_1 {
	status = "ok";
};

&ufsphy_mem {
	status = "disabled";
};

&ufshc_mem {
	status = "disabled";
};
