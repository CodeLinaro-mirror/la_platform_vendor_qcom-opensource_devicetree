// SPDX-License-Identifier: BSD-3-Clause
/*
 * Copyright (c) 2025 Qualcomm Innovation Center, Inc. All rights reserved.
 */

#include "katmai-fp2p5.dtsi"

/ {
	model = "Qualcomm Technologies, Inc. KATMAIP-FP2P5 SoC";
	compatible = "qcom,yupikp-iot";
	qcom,msm-id = <0x2000023F 0x10000>;
};
