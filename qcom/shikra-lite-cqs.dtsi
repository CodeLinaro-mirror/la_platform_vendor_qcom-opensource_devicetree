// SPDX-License-Identifier: BSD-3-Clause
/*
 * Copyright (c) Qualcomm Technologies, Inc. and/or its subsidiaries.
 */

#include "shikra.dtsi"

/ {
	model = "Qualcomm Technologies, Inc. Shikra Lite CQS SoC";
	compatible = "qcom,shikra-lite-cqs";
	qcom,msm-id = <758 0x10000>;
};
