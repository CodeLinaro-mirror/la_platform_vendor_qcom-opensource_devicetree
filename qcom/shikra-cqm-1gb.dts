// SPDX-License-Identifier: BSD-3-Clause
/*
 * Copyright (c) Qualcomm Technologies, Inc. and/or its subsidiaries.
 */

/dts-v1/;

#include "shikra-cqm.dtsi"
#include "shikra-1gb.dtsi"

/ {
	model = "Qualcomm Technologies, Inc. Shikra CQM SoC 1GB DDR";
	compatible = "qcom,shikra-cqm";
	qcom,board-id = <0 0x300>;
};
