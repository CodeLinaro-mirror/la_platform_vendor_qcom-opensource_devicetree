// SPDX-License-Identifier: BSD-3-Clause
/*
 * Copyright (c) 2025 Qualcomm Innovation Center, Inc. All rights reserved.
 */

&sdhc_1 {
	status = "okay";
	vdd-supply = <&L20A>;
	qcom,vdd-voltage-level = <2952000 2952000>;
	qcom,vdd-current-level = <0 150000>;

	vdd-io-supply = <&L16A>;
	qcom,vdd-io-always-on;
	qcom,vdd-io-lpm-sup;
	qcom,vdd-io-voltage-level = <1800000 1800000>;
	qcom,vdd-io-current-level = <0 200120>;

	mmc-ddr-1_8v;
	mmc-hs200-1_8v;
	mmc-hs400-1_8v;
	mmc-hs400-enhanced-strobe;

	pinctrl-names = "default", "sleep";
	pinctrl-0 = <&sdc1_on>;
	pinctrl-1 = <&sdc1_off>;
};

&sdhc_3 {

	/* device communication power supply for msm_io*/
	vdd-io-supply = <&L11A>;
	qcom,vdd-io-voltage-level = <1800000 1800000>;
	qcom,vdd-io-always-on;
	qcom,vdd-io-current-level = <200 22697>;

	keep-power-in-suspend;
	qcom,core_3_0v_support;
	no-sd;
	no-mmc;
	qcom,restore-after-cx-collapse;
	pinctrl-names = "default", "sleep";
	pinctrl-0 = <&sdc3_clk_on &sdc3_cmd_on &sdc3_data_on>;
	pinctrl-1 = <&sdc3_clk_off &sdc3_cmd_off &sdc3_data_off>;
	/* forbid SDR104/SDR50/DDR50 for hi3881 */
	sdhci-caps-mask = <0x7 0x0>;

	max-frequency = <50000000>;

	status = "ok";
};

