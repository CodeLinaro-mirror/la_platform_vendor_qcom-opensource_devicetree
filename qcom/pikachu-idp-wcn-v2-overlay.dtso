// SPDX-License-Identifier: BSD-3-Clause
/*
 * Copyright (c) Qualcomm Technologies, Inc. and/or its subsidiaries.
 */

/dts-v1/;
/plugin/;

#include "pikachu-idp-wcn-v2.dtsi"

/ {
        model = "Qualcomm Technologies, Inc. Pikachu WCN v2.0 IDP";
        compatible = "qcom,pikachu-idp", "qcom,pikachu", "qcom,idp";
        qcom,msm-id = <736 0x10000>;
        qcom,board-id = <0x20022 0>;
};
