// SPDX-License-Identifier: BSD-3-Clause
/*
 * Copyright (c) 2024 Qualcomm Innovation Center, Inc. All rights reserved.
 */

#include "canoe.dtsi"

/ {
		model = "Qualcomm Technologies, Inc. Honu";
		compatible = "qcom,honu";
		qcom,msm-id = <0x30294 0x10000>;
};

