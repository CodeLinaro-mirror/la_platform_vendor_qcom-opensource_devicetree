// SPDX-License-Identifier: BSD-3-Clause
/*
 * Copyright (c) Qualcomm Technologies, Inc. and/or its subsidiaries.
 */

&chosen {
	bootargs = "printk.devkmsg=on loglevel=8 nokaslr kpti=0 log_buf_len=256K swiotlb=0 slub_debug=- cpufreq.default_governor=performance";
};

&arch_timer {
	clock-frequency = <5000000>;
};

&memtimer {
	clock-frequency = <5000000>;
};
