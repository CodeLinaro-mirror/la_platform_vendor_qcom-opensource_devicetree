// SPDX-License-Identifier: BSD-3-Clause
/*
 * Copyright (c) 2024 Qualcomm Innovation Center, Inc. All rights reserved.
 */

/dts-v1/;

#include "honu-tp.dtsi"

/ {
		model = "Qualcomm Technologies, Inc. Honu Alt. Thermal Profile SoC";
		compatible = "qcom,honu";
		qcom,board-id = <0 0>;
};
