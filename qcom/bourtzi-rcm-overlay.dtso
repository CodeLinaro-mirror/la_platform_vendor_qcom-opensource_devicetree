// SPDX-License-Identifier: BSD-3-Clause
/*
 * Copyright (c) Qualcomm Technologies, Inc. and/or its subsidiaries.
 */

/dts-v1/;
/plugin/;

#include "bourtzi-rcm.dtsi"

/ {
	model = "Qualcomm Technologies, Inc. Bourtzi RCM + WCN3998 + tioman";
	compatible = "qcom,bourtzi-rcm", "qcom,rcm", "qcom,bourtzi";
	qcom,msm-id = <776 0x10000>;
	qcom,board-id = <0x10015 0x0>;
};
