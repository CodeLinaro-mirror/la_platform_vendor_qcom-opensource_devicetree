// SPDX-License-Identifier: BSD-3-Clause
/*
 * Copyright (c) 2024-2025 Qualcomm Innovation Center, Inc. All rights reserved.
 */
&arch_timer {
	clock-frequency = <5000000>;
};

&cam_rsc {
	status = "disabled";
};
