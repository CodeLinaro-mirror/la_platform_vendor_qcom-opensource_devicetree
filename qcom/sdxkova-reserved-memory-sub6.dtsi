// SPDX-License-Identifier: BSD-3-Clause
/*
 * Copyright (c) 2025 Qualcomm Innovation Center, Inc. All rights reserved.
 */

#include "sdxkova-reserved-memory.dtsi"

/delete-node/ &dsm_partition_2_mem;

&dsm_partition_1_mem {
	no-map;
	reg = <0x0 0x8b400000 0x0 0x3780000>;
};

&mpssadsp_mem {
	no-map;
	reg = <0x0 0x8ec00000 0x0 0xeb00000>;
};

&modem_pas {
/delete-property/ compatible;
/delete-property/ memory-region;

	compatible = "qcom,sdxpinn-modem-pas-sub6";

	memory-region = <&mpssadsp_mem>,
			<&q6_mpss_dtb_mem>,
			<&system_cma>,
			<&dsm_partition_1_mem>,
			<&qlink_logging_mem>;
};
