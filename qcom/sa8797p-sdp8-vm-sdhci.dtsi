// SPDX-License-Identifier: BSD-3-Clause
/*
 * Copyright (c) Qualcomm Technologies, Inc. and/or its subsidiaries.
 */

&soc {
	sdhc_4_mem_region0: sdhc_4_mem_region@0 {
		/*
		 * Restrict IOVA mappings for SDHC4 buffers to the 256 MB region
		 * from 0x40000000 - 0x4fffffff.
		 */
		iommu-addresses = <&sdhc_4 0x0 0x40000000>,
				  <&sdhc_4 0x50000000 0xb0000000>;
	};

	sdhc_4: sdhci@00b84000 {
		compatible = "qcom,sa7255-sdhci";

		reg = <0x00b84000 0x1000>;
		reg-names = "hc";

		interrupts = <GIC_SPI 261 IRQ_TYPE_LEVEL_HIGH>,
			     <GIC_SPI 227 IRQ_TYPE_LEVEL_HIGH>;
		interrupt-names = "hc_irq", "pwr_irq";

		bus-width = <4>;

		no-sdio;
		no-mmc;
		non-removable;

		cap-sd-highspeed;
		no-1-8-v;
		max-frequency = <50000000>;

		memory-region = <&sdhc_4_mem_region0>;
		iommus = <&apps_smmu_0 0x1580 0x0>;
		qcom,iommu-dma = "fastmap";
		dma-coherent;

		power-domains = <&scmi_power 30>, <&scmi_perf 5>;
		power-domain-names = "power", "perf";
		status = "okay";
	};

};
