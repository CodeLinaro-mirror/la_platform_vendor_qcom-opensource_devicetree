// SPDX-License-Identifier: BSD-3-Clause
/*
 * Copyright (c) Qualcomm Technologies, Inc. and/or its subsidiaries.
 */

/dts-v1/;
/plugin/;

#include "malabar-mtp-4gb.dtsi"
#include "malabar-pm7250b.dtsi"

/ {
       model = "Qualcomm Technologies, Inc. Malabar MTP 4GB DDR";
       compatible = "qcom,malabar-mtp", "qcom,malabar", "qcom,mtp";
       qcom,msm-id = <733 0x10000>;
       qcom,board-id = <0x10008 0x600>;
};

