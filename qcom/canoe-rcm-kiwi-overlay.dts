// SPDX-License-Identifier: BSD-3-Clause
/*
 * Copyright (c) 2024 Qualcomm Innovation Center, Inc. All rights reserved.
 */

/dts-v1/;
/plugin/;

#include "canoe-rcm-kiwi.dtsi"

/ {
	model = "Qualcomm Technologies, Inc. Canoe RCM Kiwi WLAN";
	compatible = "qcom,canoe-rcm", "qcom,canoe", "qcom,rcm";
	qcom,msm-id = <0x10294 0x10000>, <0x10294 0x20000>, <0x10295 0x10000>, <0x10295 0x20000>,
			  <0x30294 0x10000>, <0x30294 0x20000>, <0x30295 0x10000>, <0x30295 0x20000>,
			  <0x1010294 0x10000>, <0x1010294 0x20000>, <0x1010295 0x10000>,
			  <0x1010295 0x20000>, <0x1030294 0x10000>, <0x1030294 0x20000>,
			  <0x1030295 0x10000>, <0x1030295 0x20000>;
	qcom,board-id = <0x1000015 0>;
};
