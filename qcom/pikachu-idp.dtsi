// SPDX-License-Identifier: BSD-3-Clause
/*
 * Copyright (c) Qualcomm Technologies, Inc. and/or its subsidiaries.
 */

#include "pikachu-idp-base.dtsi"

&apps_rsc_drv2 {
	rpmh-regulator-gfxlvl {
		status = "okay";
	};
};
