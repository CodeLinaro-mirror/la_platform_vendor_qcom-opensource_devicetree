// SPDX-License-Identifier: BSD-3-Clause
/*
 * Copyright (c) Qualcomm Technologies, Inc. and/or its subsidiaries.
 */

#include "malabar-pmic-overlay.dtsi"
#include <dt-bindings/gpio/gpio.h>

&sdhc_2 {
	vdd-supply = <&L24B_E0>;
	qcom,vdd-voltage-level = <2960000 2960000>;
	qcom,vdd-current-level = <0 976210>;

	vdd-io-supply = <&L28B_E0>;
	qcom,vdd-io-voltage-level = <1800000 2960000>;
	qcom,vdd-io-current-level = <0 22000>;

	pinctrl-names = "default", "sleep";
	pinctrl-0 = <&sdc2_on>;
	pinctrl-1 = <&sdc2_off>;

	cd-gpios = <&tlmm 79 GPIO_ACTIVE_LOW>;

	status = "ok";
};

#include "malabar-pmiv010x.dtsi"

&pmiv010x_amoled {
	status = "ok";
};

&pmiv010x_amoled_ecm {
	status = "ok";
	nvmem-names = "amoled-ecm-sdam0", "amoled-ecm-sdam1";
	nvmem = <&pmk8350_sdam_13>, <&pmk8350_sdam_14>;
	interrupt-names = "ecm-sdam0", "ecm-sdam1";
	interrupts = <0x0 0x7c 0x1 IRQ_TYPE_EDGE_RISING>,
		     <0x0 0x7d 0x1 IRQ_TYPE_EDGE_RISING>;
};
