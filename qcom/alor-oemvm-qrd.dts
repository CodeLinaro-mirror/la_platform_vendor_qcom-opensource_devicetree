// SPDX-License-Identifier: BSD-3-Clause
/*
 * Copyright (c) 2025 Qualcomm Innovation Center, Inc. All rights reserved.
 */
/dts-v1/;

#include "alor-oemvm.dtsi"
#include "alor-oemvm-qrd.dtsi"

/ {
	model = "Qualcomm Technologies, Inc. Alor OEMVM QRD";
	compatible = "qcom,alor-qrd", "qcom,alor", "qcom,alorp-qrd", "qcom,alorp",
			   "qcom,qrd";
	qcom,board-id = <0x1000B 0>;
};
