// SPDX-License-Identifier: BSD-3-Clause
/*
 * Copyright (c) Qualcomm Technologies, Inc. and/or its subsidiaries.
 */

#include "canoe-qrd-st54l-kundu.dtsi"

&pmih010x_eusb2_repeater {
	qcom,param-override-seq =
		<0xc 0x51>;
};
