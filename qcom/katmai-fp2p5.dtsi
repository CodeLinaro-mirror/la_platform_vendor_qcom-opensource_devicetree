// SPDX-License-Identifier: BSD-3-Clause
/*
 * Copyright (c) 2025 Qualcomm Innovation Center, Inc. All rights reserved.
 */

#include "yupik-iot.dtsi"
#include "katmai-cpu-fp2p5.dtsi"

/ {
	model = "Qualcomm Technologies, Inc. KATMAI-FP2P5 SoC";
	compatible = "qcom,yupik-iot";
	qcom,msm-id = <0x20000240 0x10000>;
};

&pcie1 {
	status = "ok";
};

&pcie1_msi {
	status = "ok";
};
