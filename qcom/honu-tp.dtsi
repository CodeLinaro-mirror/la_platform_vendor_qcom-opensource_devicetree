// SPDX-License-Identifier: BSD-3-Clause
/*
 * Copyright (c) 2024 Qualcomm Innovation Center, Inc. All rights reserved.
 */

#include "honu.dtsi"

/ {
		model = "Qualcomm Technologies, Inc. Honu Alt. Thermal Profile SoC";
		compatible = "qcom,honu";
		qcom,msm-id = <0x1030294 0x10000>;
};
