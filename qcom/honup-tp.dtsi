// SPDX-License-Identifier: BSD-3-Clause
/*
 * Copyright (c) 2024 Qualcomm Innovation Center, Inc. All rights reserved.
 */

#include "honup.dtsi"
#include "honu-tp.dtsi"

/ {
		model = "Qualcomm Technologies, Inc. HonuP Alt. Thermal Profile SoC";
		compatible = "qcom,honup";
		qcom,msm-id = <0x1030295 0x10000>;
};
