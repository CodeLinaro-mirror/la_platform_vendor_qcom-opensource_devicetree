// SPDX-License-Identifier: BSD-3-Clause
/*
 * Copyright (c) Qualcomm Technologies, Inc. and/or its subsidiaries.
 */

/dts-v1/;
/plugin/;

#include "shikra-lite-evk-eSMPS-nfc-imxcam-1gb.dtsi"

/ {
	model = "Qualcomm Technologies, Inc. Shikra Lite EVK eSMPS NFC IMXCAM";
	compatible = "qcom,shikra-evk", "qcom,shikra", "qcom,shikra-cqm", "qcom,shikra-cqs", "qcom,evk";
	qcom,board-id = <0x10033 0x301>;
};
