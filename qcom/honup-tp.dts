// SPDX-License-Identifier: BSD-3-Clause
/*
 * Copyright (c) 2024 Qualcomm Innovation Center, Inc. All rights reserved.
 */

/dts-v1/;

#include "honup-tp.dtsi"

/ {
		model = "Qualcomm Technologies, Inc. HonuP Alt. Thermal Profile SoC";
		compatible = "qcom,honup";
		qcom,board-id = <0 0>;
};
