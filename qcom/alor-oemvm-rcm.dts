// SPDX-License-Identifier: BSD-3-Clause
/*
 * Copyright (c) 2025 Qualcomm Innovation Center, Inc. All rights reserved.
 */
/dts-v1/;

#include "alor-oemvm.dtsi"
#include "alor-oemvm-rcm.dtsi"

/ {
	model = "Qualcomm Technologies, Inc. Alor OEMVM RCM";
	compatible = "qcom,alor-rcm", "qcom,alor", "qcom,alorp-rcm", "qcom,alorp",
			   "qcom,rcm";
	qcom,board-id = <0x10015 0>;
};
