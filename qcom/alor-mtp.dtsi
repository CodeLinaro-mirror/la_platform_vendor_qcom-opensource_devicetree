// SPDX-License-Identifier: BSD-3-Clause
/*
 * Copyright (c) 2025 Qualcomm Innovation Center, Inc. All rights reserved.
 */

#include "alor-pmic-overlay.dtsi"
#include <dt-bindings/clock/qcom,alor-gcc.h>

&qupv3_se4_i2c {
	#address-cells = <1>;
	#size-cells = <0>;

	status = "ok";
	qcom,touch-active = "st,fts";

	st_fts@49 {
		compatible = "st,fts";
		reg = <0x49>;
		interrupt-parent = <&tlmm>;
		interrupts = <88 0x2008>;
		vdd-supply = <&L4B>;
		avdd-supply = <&L14B>;
		pinctrl-names = "pmx_ts_active", "pmx_ts_suspend";
		pinctrl-0 = <&ts_active>;
		pinctrl-1 = <&ts_int_suspend &ts_reset_suspend>;
		st,irq-gpio = <&tlmm 88 0x2008>;
		st,irq-flags = <8>;
		st,reset-gpio = <&tlmm 161 0x00>;
		st,regulator_dvdd = "vdd";
		st,regulator_avdd = "avdd";

		st,touch-type = "primary";
		st,qts_en;
		qts,trusted-touch-mode = "vm_mode";
		qts,touch-environment = "pvm";
		qts,trusted-touch-type = "primary";
		qts,trusted-touch-spi-irq = <755>;
		qts,trusted-touch-io-bases = <0xA90000>;
		qts,trusted-touch-io-sizes = <0x1000>;
		qts,trusted-touch-vm-gpio-list = <&tlmm 48 0 &tlmm 49 0 &tlmm 50 0
						&tlmm 51 0 &tlmm 161 0 &tlmm 88 0x2008>;
	};
};

&sdhc_2 {
	vdd-supply = <&L9B>;
	qcom,vdd-voltage-level = <2950000 2960000>;
	qcom,vdd-current-level = <33 977000>;

	vdd-io-supply = <&L8B>;
	qcom,vdd-io-voltage-level = <1800000 2960000>;
	qcom,vdd-io-current-level = <0 5830>;

	pinctrl-names = "default", "sleep";
	pinctrl-0 = <&sdc2_on>;
	pinctrl-1 = <&sdc2_off>;

	cd-gpios = <&tlmm 84 GPIO_ACTIVE_LOW>;

	resets = <&gcc GCC_SDCC2_BCR>;
	reset-names = "core_reset";

	/*
	 * By default, the Alor reference platforms use Level Shifter
	 * devices with its Feedback Clock signal connects to the MSM.
	 * Without the external feedback clock, the HS50 mode works at
	 * reduced frequency at 37.5MHz.
	 */
	qcom,uses_level_shifter;
	qcom,external-fb-clk;

	status = "ok";
};
