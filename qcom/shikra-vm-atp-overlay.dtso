// SPDX-License-Identifier: BSD-3-Clause
/*
 * Copyright (c) Qualcomm Technologies, Inc. and/or its subsidiaries.
 */
/dts-v1/;
/plugin/;

#include "shikra-vm-avf.dtsi"
#include "shikra-vm-atp-avf.dtsi"

/ {
	model = "Qualcomm Technologies, Inc. Shikra SVM ATP";
	compatible = "qcom,shikra-atp", "qcom,shikra", "qcom,shikrap-atp",
			"qcom,shikrap", "qcom,atp";
	qcom,board-id = <0 0>;

	host {
	};
};

