// SPDX-License-Identifier: BSD-3-Clause
/*
 * Copyright (c) 2025 Qualcomm Innovation Center, Inc. All rights reserved.
 */

#include "katmai.dtsi"

/ {
	model = "Qualcomm Technologies, Inc. KATMAIP SoC";
	compatible = "qcom,yupikp-iot";
	qcom,msm-id = <0x400023F 0x10000>;
};
