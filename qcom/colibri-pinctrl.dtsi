// SPDX-License-Identifier: BSD-3-Clause
/*
 *Copyright (c) Qualcomm Technologies, Inc. and/or its subsidiaries.
 */

&soc {

	tlmm: pinctrl@f000000 {
		compatible = "qcom,colibri-tlmm";
		reg = <0x400000 0x800000>;
		interrupts = <GIC_SPI 227 IRQ_TYPE_LEVEL_HIGH>;
		gpio-controller;
		#gpio-cells = <2>;
		interrupt-controller;
		#interrupt-cells = <2>;
	};
};
