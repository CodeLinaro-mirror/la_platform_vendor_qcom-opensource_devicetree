// SPDX-License-Identifier: BSD-3-Clause
/*
 * Copyright (c) 2024 Qualcomm Innovation Center, Inc. All rights reserved.
 */

#include "honup-v2.dtsi"
#include "honu-tp-v2.dtsi"

/ {
		model = "Qualcomm Technologies, Inc. HonuP Alt. Thermal Profile v2 SoC";
		compatible = "qcom,honup";
		qcom,msm-id = <0x1030295 0x20000>;
};
