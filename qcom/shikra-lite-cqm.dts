// SPDX-License-Identifier: BSD-3-Clause
/*
 * Copyright (c) Qualcomm Technologies, Inc. and/or its subsidiaries.
 */

/dts-v1/;

#include "shikra-lite-cqm.dtsi"

/ {
	model = "Qualcomm Technologies, Inc. Shikra Lite CQM SoC";
	compatible = "qcom,shikra-lite-cqm";
	qcom,board-id = <0 0>;
};
