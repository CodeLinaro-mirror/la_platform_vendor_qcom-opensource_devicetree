// SPDX-License-Identifier: BSD-3-Clause
/*
 * Copyright (c) 2025 Qualcomm Innovation Center, Inc. All rights reserved.
 */
/dts-v1/;

#include "alor-oemvm.dtsi"
#include "alor-oemvm-cdp.dtsi"

/ {
	model = "Qualcomm Technologies, Inc. Alor OEMVM CDP";
	compatible = "qcom,alor-cdp", "qcom,alor", "qcom,alorp-cdp",
			"qcom,alorp", "qcom,cdp";
	qcom,board-id = <0x10001 0>;
};
