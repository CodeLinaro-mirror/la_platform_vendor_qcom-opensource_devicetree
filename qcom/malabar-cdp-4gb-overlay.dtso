// SPDX-License-Identifier: BSD-3-Clause
/*
 * Copyright (c) Qualcomm Technologies, Inc. and/or its subsidiaries.
 */

/dts-v1/;
/plugin/;

#include "malabar-cdp-4gb.dtsi"

/ {
	model = "Qualcomm Technologies, Inc. Malabar CDP 4GB DDR";
	compatible = "qcom,malabar-cdp", "qcom,malabar", "qcom,cdp";
	qcom,msm-id = <733 0x10000>;
	qcom,board-id = <0x10001 0x600>;
};
