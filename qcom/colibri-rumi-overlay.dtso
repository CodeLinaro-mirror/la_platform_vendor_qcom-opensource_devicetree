// SPDX-License-Identifier: BSD-3-Clause
/*
 * Copyright (c) Qualcomm Technologies, Inc. and/or its subsidiaries.
 */

/dts-v1/;
/plugin/;

#include "colibri-rumi.dtsi"

/ {
  model = "Qualcomm Technologies, Inc. Colibri RUMI";
  compatible = "qcom,colibri-rumi", "qcom,colibri", "qcom,rumi";
  qcom,msm-id = <725 0x10000>; //TODO - correct soc id for colibri
  qcom,board-id = <15 0 >;
};
