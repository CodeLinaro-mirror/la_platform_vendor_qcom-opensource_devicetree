// SPDX-License-Identifier: BSD-3-Clause
/*
 * Copyright (c) 2024-2025 Qualcomm Innovation Center, Inc. All rights reserved.
 */

#include "canoe.dtsi"

/ {
	model = "Qualcomm Technologies, Inc. Canoe v2 SoC";
	compatible = "qcom,canoe";
	qcom,msm-id = <660 0x20000>;

	chosen: chosen {
		bootargs = "android_arch_task_struct_size=512 loglevel=6 log_buf_len=512K cpufreq.default_governor=performance sysctl.kernel.sched_pelt_multiplier=4 no-steal-acc kpti=0 swiotlb=0 loop.max_part=7 irqaffinity=0-1 fw_devlink.strict=1 pcie_ports=compat pci-msm-drv.pcie_sm_regs=0x1D07000,0x1040,0x1048,0x3000,0x1 kasan=off rcupdate.rcu_expedited=1 rcu_nocbs=0-7 cgroup_disable=pressure printk.console_no_auto_verbose=1 kernel.panic_on_rcu_stall=1 ftrace_dump_on_oops disable_dma32=on restrict_cma_redirect=false";
	};

};

