// SPDX-License-Identifier: BSD-3-Clause
/*
 *  Copyright (c) Qualcomm Technologies, Inc. and/or its subsidiaries.
 */

#include "malabar.dtsi"

/ {
	model = "Qualcomm Technologies, Inc. Malabar QMB SoC";
	compatible = "qcom,malabar-qmb";
	qcom,msm-id = <800 0x10000>;
};

