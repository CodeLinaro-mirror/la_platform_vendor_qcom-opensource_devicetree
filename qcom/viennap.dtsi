// SPDX-License-Identifier: BSD-3-Clause
/*
 * Copyright (c) Qualcomm Technologies, Inc. and/or its subsidiaries.
 */

#include "vienna.dtsi"

/ {
	model = "Qualcomm Technologies, Inc. ViennaP SoC";
	compatible = "qcom,viennap";
	qcom,msm-id = <670 0x10000>;
};

&mpss_mem {
	reg = <0x0 0x8ba00000 0x0 0x3c00000>;
};

&q6_mpss_dtb_mem {
	reg = <0x0 0x8f600000 0x0 0x80000>;
};
