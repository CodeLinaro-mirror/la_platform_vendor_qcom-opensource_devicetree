// SPDX-License-Identifier: BSD-3-Clause
/*
 * Copyright (c) Qualcomm Technologies, Inc. and/or its subsidiaries.
 */

#include "chora-pmic-overlay.dtsi"
#include "chora-pm7550ba-smb1500.dtsi"
#include "chora-thermal-overlay.dtsi"

&qupv3_se4_spi {
	#address-cells = <1>;
	#size-cells = <0>;

	qcom,touch-active = "goodix,gt9916S";
	status = "ok";

	goodix-berlin@0 {
		compatible = "goodix,gt9916S";
		reg = <0>;
		spi-max-frequency = <1000000>;
		interrupt-parent = <&tlmm>;
		interrupts = <1 0x2008>;
		goodix,reset-gpio = <&tlmm 0 0x00>;
		goodix,irq-gpio = <&tlmm 1 0x2008>;
		goodix,irq-flags = <2>;
		goodix,panel-max-x = <1080>;
		goodix,panel-max-y = <2400>;
		goodix,panel-max-w = <255>;
		goodix,panel-max-p = <4096>;
		goodix,firmware-name = "goodix_firmware_spi.bin";
		goodix,config-name = "goodix_cfg_group_spi.bin";
		goodix,avdd-name = "avdd";
		goodix,iovdd-name = "iovdd";
		avdd-supply = <&L22B>;
		iovdd-supply = <&L9B>;
		pinctrl-names = "pmx_ts_active", "pmx_ts_suspend", "pmx_ts_release";
		pinctrl-0 = <&ts_active>;
		pinctrl-1 = <&ts_int_suspend &ts_reset_suspend>;
		pinctrl-2 = <&ts_release>;
		goodix,touch-type = "primary";
		goodix,qts_en;
	};
};
