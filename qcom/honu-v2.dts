// SPDX-License-Identifier: BSD-3-Clause
/*
 * Copyright (c) 2024 Qualcomm Innovation Center, Inc. All rights reserved.
 */

/dts-v1/;

#include "honu-v2.dtsi"

/ {
		model = "Qualcomm Technologies, Inc. Honu Alt. Thermal Profile v2 SoC";
		compatible = "qcom,honu";
		qcom,board-id = <0 0>;
};
