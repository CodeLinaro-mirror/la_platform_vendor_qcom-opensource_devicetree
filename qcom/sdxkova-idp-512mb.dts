// SPDX-License-Identifier: BSD-3-Clause
/*
 * Copyright (c) 2024 Qualcomm Innovation Center, Inc. All rights reserved.
 */

/dts-v1/;

#include "sdxkova.dtsi"
#include "sdxkova-idp-mbb.dtsi"
#include "sdxkova-idp-512mb.dtsi"
#include "sdxkova-reserved-memory-512mb.dtsi"
/ {
	model = "Qualcomm Technologies, Inc. SDXKOVA IDP MIN 512MB";
	compatible = "qcom,sdxkova-idp",
		"qcom,sdxkova", "qcom,idp";
	qcom,msm-id = <556 0x10000>;
	qcom,board-id = <0x4040022 0x204>;
};
