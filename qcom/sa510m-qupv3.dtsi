// SPDX-License-Identifier: BSD-3-Clause
/*
 * Copyright (c) 2024 Qualcomm Innovation Center, Inc. All rights reserved.
 */

&soc {
	/* QUPv3_0 wrapper instance */
	qupv3_0: geniup@9c0000 {
		compatible = "qcom,geni-se-qup";
		reg = <0x9c0000 0x2000>;
		#address-cells = <1>;
		#size-cells = <1>;
		ranges;
		status = "ok";

		 /* PORed Debug UART Instance */
		qupv3_se3_2uart: serial@98c000 {
			compatible = "qcom,geni-debug-uart";
			reg = <0x98c000 0x4000>;
			reg-names = "se_phys";
			interrupts = <GIC_SPI 58 IRQ_TYPE_LEVEL_HIGH>;
			status = "disabled";
		};
	};
};
