// SPDX-License-Identifier: BSD-3-Clause
/*
 * Copyright (c) Qualcomm Technologies, Inc. and/or its subsidiaries.
 */

/dts-v1/;

#include "shikra-lite-cqs.dtsi"

/ {
	model = "Qualcomm Technologies, Inc. Shikra Lite CQS SoC";
	compatible = "qcom,shikra-lite-cqs";
	qcom,board-id = <0 0>;
};
