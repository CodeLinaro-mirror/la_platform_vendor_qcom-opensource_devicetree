// SPDX-License-Identifier: BSD-3-Clause
/*
 * Copyright (c) 2024 Qualcomm Innovation Center, Inc. All rights reserved.
 */

#include <dt-bindings/interrupt-controller/irq.h>
#include <dt-bindings/spmi/spmi.h>

pmh0104@9 {
	compatible = "qcom,spmi-pmic";
	reg = <9 SPMI_USID>;
	#address-cells = <1>;
	#size-cells = <0>;

	pmh0104_tz: pmh0104-temp-alarm@a00 {
		compatible = "qcom,spmi-temp-alarm";
		reg = <0xa00>;
		interrupts = <0x9 0xa 0x0 IRQ_TYPE_EDGE_BOTH>;
		#thermal-sensor-cells;
	};

	pmh0104_gpios: pinctrl@8800 {
		compatible = "qcom,pmh0104-gpio";
		reg = <0x8800>;
		gpio-controller;
		#gpio-cells = <2>;
		interrupt-controller;
		#interrupt-cells = <2>;
	};
};
