// SPDX-License-Identifier: BSD-3-Clause
/*
 * Copyright (c) 2025 Qualcomm Innovation Center, Inc. All rights reserved.
 */

/dts-v1/;

#include "sa510m.dtsi"

/ {
	model = "Qualcomm Technologies, Inc. SA510M WLAN OVER ROME IDP";
	compatible = "qcom,sa510m-idp",
		"qcom,sa510m", "qcom,idp";
	qcom,msm-id = <697 0x10000>;
	qcom,board-id = <0x22 0x201>, <0x22 0x301>;
};

&qnand_1 {
	status = "ok";
};
