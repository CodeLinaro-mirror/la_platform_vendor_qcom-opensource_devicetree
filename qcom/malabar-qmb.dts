// SPDX-License-Identifier: BSD-3-Clause
/*
 *  Copyright (c) Qualcomm Technologies, Inc. and/or its subsidiaries.
 */

/dts-v1/;

#include "malabar-qmb.dtsi"

/ {
	model = "Qualcomm Technologies, Inc. Malabar QMB SoC";
	compatible = "qcom,malabar-qmb";
	qcom,board-id = <0 0>;
};

