// SPDX-License-Identifier: BSD-3-Clause
/*
 * Copyright (c) Qualcomm Technologies, Inc. and/or its subsidiaries.
 */

/dts-v1/;
/plugin/;

#include "malabar-mtp-emmc-wcn3950.dtsi"

/ {
        model = "Qualcomm Technologies, Inc. Malabar MTP + WCN3950 + EMMC";
        compatible = "qcom,malabar-mtp", "qcom,malabar", "qcom,malabarp-mtp", "qcom,malabarp",
                        "qcom,mtp", "qcom,malabar-qmb";
        qcom,msm-id = <733 0x10000>, <757 0x10000>, <800 0x10000>;
        qcom,board-id = <0x20008 1>;
};
