## Documentation/devicetree/bindings/embedded-controller/qcom,glymur-crd-ec.yaml
```yaml
# SPDX-License-Identifier: (GPL-2.0-only OR BSD-2-Clause)
%YAML 1.2
---
$id: http://devicetree.org/schemas/embedded-controller/qcom,glymur-crd-ec.yaml#
$schema: http://devicetree.org/meta-schemas/core.yaml#

title: Qualcomm Glymur Embedded Controller

maintainers:
  - Sibi Sankar <sibi.sankar@oss.qualcomm.com>
  - Anvesh Jain P <anvesh.p@oss.qualcomm.com>

description:
  Qualcomm Snapdragon based Glymur reference devices have an EC running
  on different MCU chips. The EC handles things like fan control,
  temperature sensors, access to EC internal state changes.

properties:
  compatible:
    const: qcom,glymur-crd-ec

  reg:
    const: 0x76

  interrupts:
    maxItems: 1

required:
  - compatible
  - reg
  - interrupts

additionalProperties: false

examples:
  - |
    #include <dt-bindings/interrupt-controller/irq.h>
    i2c {
        #address-cells = <1>;
        #size-cells = <0>;

        embedded-controller@76 {
            compatible = "qcom,glymur-crd-ec";
            reg = <0x76>;

            interrupts-extended = <&tlmm 66 IRQ_TYPE_LEVEL_HIGH>;
        };
    };
...
```
